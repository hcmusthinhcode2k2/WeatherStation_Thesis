#include "libcomp.h"
#include "KX126.h"

#ifndef USE_KX126_DEBUG
#undef __db
#define __db(...)
#endif

/* Register */
const uint8_t KX126_REG_MANUFACTURING_ID=0x00;
const uint8_t KX126_REG_PART_ID=0x01;
const uint8_t KX126_REG_X_AXIS_HIGH_PASS_LOW=0x02;
const uint8_t KX126_REG_X_AXIS_HIGH_PASS_HIGH=0x03;
const uint8_t KX126_REG_Y_AXIS_HIGH_PASS_LOW=0x04;
const uint8_t KX126_REG_Y_AXIS_HIGH_PASS_HIGH=0x05;
const uint8_t KX126_REG_Z_AXIS_HIGH_PASS_LOW=0x06;
const uint8_t KX126_REG_Z_AXIS_HIGH_PASS_HIGH=0x07;
const uint8_t KX126_REG_X_AXIS_OUTPUT_LOW=0x08;
const uint8_t KX126_REG_X_AXIS_OUTPUT_HIGH=0x09;
const uint8_t KX126_REG_Y_AXIS_OUTPUT_LOW=0x0A;
const uint8_t KX126_REG_Y_AXIS_OUTPUT_HIGH=0x0B;
const uint8_t KX126_REG_Z_AXIS_OUTPUT_LOW=0x0C;
const uint8_t KX126_REG_Z_AXIS_OUTPUT_HIGH=0x0D;
const uint8_t KX126_REG_PAD_STEP_LOW=0x0E;
const uint8_t KX126_REG_PAD_STEP_HIGH=0x0F;
const uint8_t KX126_REG_COMMAND_TEST_RESPONSE=0x10;
const uint8_t KX126_REG_WHO_AM_I=0x11;
const uint8_t KX126_REG_CURRENT_TILT_POSITION=0x12;
const uint8_t KX126_REG_PREVIOUS_TILT_POSITION=0x13;
const uint8_t KX126_REG_INS1=0x14;
const uint8_t KX126_REG_INS2=0x15;
const uint8_t KX126_REG_INS3=0x16;
const uint8_t KX126_REG_STATUS=0x17;
const uint8_t KX126_REG_INT_REL=0x19;
const uint8_t KX126_REG_CONTROL_1=0x1A;
const uint8_t KX126_REG_CONTROL_2=0x1B;
const uint8_t KX126_REG_CONTROL_3=0x1C;
const uint8_t KX126_REG_CONTROL_4=0x1D;
const uint8_t KX126_REG_CONTROL_5=0x1E;
const uint8_t KX126_REG_OUTPUT_DATA_CONTROL=0x1F;
const uint8_t KX126_REG_INTERRUPT_CONTROL_1=0x20;
const uint8_t KX126_REG_INTERRUPT_CONTROL_2=0x21;
const uint8_t KX126_REG_INTERRUPT_CONTROL_3=0x22;
const uint8_t KX126_REG_INTERRUPT_CONTROL_4=0x23;
const uint8_t KX126_REG_INTERRUPT_CONTROL_5=0x24;
const uint8_t KX126_REG_INTERRUPT_CONTROL_6=0x25;
const uint8_t KX126_REG_INTERRUPT_CONTROL_7=0x26;
const uint8_t KX126_REG_TILT_TIMER=0x27;
const uint8_t KX126_REG_TAP_REPORT_CONTROL=0x28;
const uint8_t KX126_REG_DOUBLE_TAP_EVENT=0x29;
const uint8_t KX126_REG_TAP_THRESHOLD_HIGH=0x2A;
const uint8_t KX126_REG_TAP_THRESHOLD_LOW=0x2B;
const uint8_t KX126_REG_FTD=0x2C;
const uint8_t KX126_REG_STD=0x2D;
const uint8_t KX126_REG_TLT=0x2E;
const uint8_t KX126_REG_TWS=0x2F;
const uint8_t KX126_REG_FREE_FALL_THRESHOLD=0x30;
const uint8_t KX126_REG_FREE_FALL_COUNTER=0x31;
const uint8_t KX126_REG_FREE_FALL_CONTROL=0x32;
const uint8_t KX126_REG_TILT_ANGLE_LL=0x34;
const uint8_t KX126_REG_TILT_ANGLE_HL=0x35;
const uint8_t KX126_REG_HYSTERESIS_SET=0x36;
const uint8_t KX126_REG_LOW_POWER_CONTROL=0x37;
const uint8_t KX126_REG_WUFTH=0x3C;
const uint8_t KX126_REG_BTSWUFTH=0x3D;
const uint8_t KX126_REG_BTSTH=0x3E;
const uint8_t KX126_REG_BTS_MOTION_DETECTION=0x3F;
const uint8_t KX126_REG_WUF_MOTION_DETECTION=0x40;
const uint8_t KX126_REG_PED_STPWM_LOW=0x41;
const uint8_t KX126_REG_PED_STPWM_HIGH=0x42;
const uint8_t KX126_REG_PEDOMETER_CONTROL_1=0x43;
const uint8_t KX126_REG_PEDOMETER_CONTROL_2=0x44;
const uint8_t KX126_REG_PEDOMETER_CONTROL_3=0x45;
const uint8_t KX126_REG_PEDOMETER_CONTROL_4=0x46;
const uint8_t KX126_REG_PEDOMETER_CONTROL_5=0x47;
const uint8_t KX126_REG_PEDOMETER_CONTROL_6=0x48;
const uint8_t KX126_REG_PEDOMETER_CONTROL_7=0x49;
const uint8_t KX126_REG_PEDOMETER_CONTROL_8=0x4A;
const uint8_t KX126_REG_PEDOMETER_CONTROL_9=0x4B;
const uint8_t KX126_REG_PEDOMETER_CONTROL_10=0x4C;
const uint8_t KX126_REG_SELF_TEST=0x4D;
const uint8_t KX126_REG_BUFFER_CONTROL_1=0x5A;
const uint8_t KX126_REG_BUFFER_CONTROL_2=0x5B;
const uint8_t KX126_REG_BUFFER_STATUS_1=0x5C;
const uint8_t KX126_REG_BUFFER_STATUS_2=0x5D;
const uint8_t KX126_REG_BUFFER_CLEAR=0x5E;
const uint8_t KX126_REG_BUFFER_READ=0x5F;


/* Tilt Position Registers (R)*/
const uint8_t KX126_POSITON_BIT_LEFT_X_NEGATIVE=0x20;
const uint8_t KX126_POSITON_BIT_RIGHT_X_POSITIVE=0x10;
const uint8_t KX126_POSITON_BIT_DOWN_Y_NEGATIVE=0x08;
const uint8_t KX126_POSITON_BIT_UP_Y_POSITIVE=0x04;
const uint8_t KX126_POSITON_BIT_FACE_DOWN_Y_NEGATIVE=0x02;
const uint8_t KX126_POSITON_BIT_FACE_UP_Y_POSITIVE=0x01;

/* Interrupt Source Registers (R)*/
/* INS 1 */
const uint8_t KX126_INS1_STPOVI=0x80;
const uint8_t KX126_INS1_STPWMI=0x40;
const uint8_t KX126_INS1_TLE=0x20;
const uint8_t KX126_INS1_TRI=0x10;
const uint8_t KX126_INS1_TDO=0x08;
const uint8_t KX126_INS1_TUO=0x04;
const uint8_t KX126_INS1_TFD=0x02;
const uint8_t KX126_INS1_TFU=0x01;
/* INS 2 */
const uint8_t KX126_INS2_FFS=0x80;
const uint8_t KX126_INS2_BFI=0x40;
const uint8_t KX126_INS2_WMI=0x20;
const uint8_t KX126_INS2_DRDY=0x10;
const uint8_t KX126_INS2_TDTS_NO_TAP=0x00;
const uint8_t KX126_INS2_TDTS_SINGLE_TAP=0x04;
const uint8_t KX126_INS2_TDTS_DOUBLE_TAP=0x08;
const uint8_t KX126_INS2_STPINCI=0x02;
const uint8_t KX126_INS2_TPS=0x01;
/* INS 3 */
const uint8_t KX126_INS3_WUFS=0x80;
const uint8_t KX126_INS3_BTS=0x40;
const uint8_t KX126_INS3_XNWU=0x20;
const uint8_t KX126_INS3_XPWU=0x10;
const uint8_t KX126_INS3_YNWU=0x08;
const uint8_t KX126_INS3_YPWU=0x04;
const uint8_t KX126_INS3_ZNWU=0x02;
const uint8_t KX126_INS3_ZPWU=0x01;

/* Status (STAT) (R)*/
const uint8_t KX126_STATUS_NO_INT=0x00;
const uint8_t KX126_STATUS_INT_ACTIVE=0x10;
const uint8_t KX126_STATUS_BACK_TO_SLEEP=0x00;
const uint8_t KX126_STATUS_WAKE_UP=0x01;

/* Control register 1 (CNTL1)(RW)*/
const uint8_t KX126_CNTL1_MODE_STAND_BY=0x00;
const uint8_t KX126_CNTL1_MODE_LOW_POWER=0x80;
const uint8_t KX126_CNTL1_RES_MODE_HIGHER_NOISE=0x00;
const uint8_t KX126_CNTL1_RES_MODE_LOWER_NOISE=0x40;
const uint8_t KX126_CNTL1_DATA_READY_DISABLE=0x00;
const uint8_t KX126_CNTL1_DATA_READY_ENABLE=0x20;
const uint8_t KX126_CNTL1_G_RANGE_2g=0x00;
const uint8_t KX126_CNTL1_G_RANGE_4g=0x08;
const uint8_t KX126_CNTL1_G_RANGE_8g=0x10;
const uint8_t KX126_CNTL1_TAP_DISABLE=0x00;
const uint8_t KX126_CNTL1_TAP_ENABLE=0x04;
const uint8_t KX126_CNTL1_PEDOMETER_DISABLE=0x00;
const uint8_t KX126_CNTL1_PEDOMETER_ENABLE=0x02;
const uint8_t KX126_CNTL1_TILT_DISABLE=0x00;
const uint8_t KX126_CNTL1_TILT_ENABLE=0x01;

/* Control register 2 */
const uint8_t KX126_CNTL2_SOFTWARE_RESET_ACTIVE=0x80;
const uint8_t KX126_CNTL2_SOFTWARE_RESET_NO_ACTIVE=0x00;
const uint8_t KX126_CNTL2_COMMAND_TEST_ACTIVE=0x40;
const uint8_t KX126_CNTL2_COMMAND_TEST_NO_ACTIVE=0x00;
const uint8_t KX126_CNTL2_LEFT_STATE_ENABLE=0x20;
const uint8_t KX126_CNTL2_RIGHT_STATE_ENABLE=0x10;
const uint8_t KX126_CNTL2_DOWN_STATE_ENABLE=0x08;
const uint8_t KX126_CNTL2_UP_STATE_ENABLE=0x04;
const uint8_t KX126_CNTL2_FACE_DOWN_STATE_ENABLE=0x02;
const uint8_t KX126_CNTL2_FACE_UP_STATE_ENABLE=0x01;

/* Control register 3 */
const uint8_t KX126_CNTL3_OTP_OUTPUT_DATA_RATE_1_563Hz=0x00;
const uint8_t KX126_CNTL3_OTP_OUTPUT_DATA_RATE_6_25Hz=0x40;
const uint8_t KX126_CNTL3_OTP_OUTPUT_DATA_RATE_12_5Hz=0x80; // Def
const uint8_t KX126_CNTL3_OTP_OUTPUT_DATA_RATE_50Hz=0xC0;
const uint8_t KX126_CNTL3_TAP_OUTPUT_DATA_RATE_50Hz=0x00;
const uint8_t KX126_CNTL3_TAP_OUTPUT_DATA_RATE_100Hz=0x08;
const uint8_t KX126_CNTL3_TAP_OUTPUT_DATA_RATE_200Hz=0x10;
const uint8_t KX126_CNTL3_TAP_OUTPUT_DATA_RATE_400Hz=0x18; // Def
const uint8_t KX126_CNTL3_TAP_OUTPUT_DATA_RATE_12_5Hz=0x20;
const uint8_t KX126_CNTL3_TAP_OUTPUT_DATA_RATE_25Hz=0x28;
const uint8_t KX126_CNTL3_TAP_OUTPUT_DATA_RATE_800Hz=0x30;
const uint8_t KX126_CNTL3_TAP_OUTPUT_DATA_RATE_1600Hz=0x38;
const uint8_t KX126_CNTL3_OWUF_OUTPUT_DATA_RATE_0_781Hz=0x00; // Def
const uint8_t KX126_CNTL3_OWUF_OUTPUT_DATA_RATE_1_563Hz=0x01;
const uint8_t KX126_CNTL3_OWUF_OUTPUT_DATA_RATE_3_125Hz=0x02;
const uint8_t KX126_CNTL3_OWUF_OUTPUT_DATA_RATE_6_250Hz=0x03;
const uint8_t KX126_CNTL3_OWUF_OUTPUT_DATA_RATE_12_5Hz=0x04;
const uint8_t KX126_CNTL3_OWUF_OUTPUT_DATA_RATE_25Hz=0x05;
const uint8_t KX126_CNTL3_OWUF_OUTPUT_DATA_RATE_50Hz=0x06;
const uint8_t KX126_CNTL3_OWUF_OUTPUT_DATA_RATE_100Hz=0x07;

/* Control register 4 */
const uint8_t KX126_CNTL4_COUNTER_CLEAR_MODE=0x00;
const uint8_t KX126_CNTL4_COUNTER_DECREMENT_MODE=0x80;
const uint8_t KX126_CNTL4_THRESHOLD_MODE_ABSOLUTE=0x00;
const uint8_t KX126_CNTL4_THRESHOLD_MODE_RELATIVE=0x40;
const uint8_t KX126_CNTL4_WAKE_UP_DISABLE=0x00;
const uint8_t KX126_CNTL4_WAKE_UP_ENABLE=0x20;
const uint8_t KX126_CNTL4_BACK_TO_SLEEP_DISABLE=0x00;
const uint8_t KX126_CNTL4_BACK_TO_SLEEP_ENABLE=0x10;
const uint8_t KX126_CNTL4_HIGH_PASS_DISABLE=0x00;
const uint8_t KX126_CNTL4_HIGH_PASS_ENABLE=0x08;
const uint8_t KX126_CNTL4_OBTS_OUTPUT_DATA_RATE_0_781Hz=0x00; // Def
const uint8_t KX126_CNTL4_OBTS_OUTPUT_DATA_RATE_1_563Hz=0x01;
const uint8_t KX126_CNTL4_OBTS_OUTPUT_DATA_RATE_3_125Hz=0x02;
const uint8_t KX126_CNTL4_OBTS_OUTPUT_DATA_RATE_6_250Hz=0x03;
const uint8_t KX126_CNTL4_OBTS_OUTPUT_DATA_RATE_12_5Hz=0x04;
const uint8_t KX126_CNTL4_OBTS_OUTPUT_DATA_RATE_25Hz=0x05;
const uint8_t KX126_CNTL4_OBTS_OUTPUT_DATA_RATE_50Hz=0x06;
const uint8_t KX126_CNTL4_OBTS_OUTPUT_DATA_RATE_100Hz=0x07;

/* Control register 5 */
const uint8_t KX126_CNTL5_MANUAL_WAKE_UP_0=0x00;
const uint8_t KX126_CNTL5_MANUAL_WAKE_UP_1=0x02;
const uint8_t KX126_CNTL5_MANUAL_SLEEP_UP_0=0x00;
const uint8_t KX126_CNTL5_MANUAL_SLEEP_UP_1=0x01;

/* Output data control */
const uint8_t KX126_ODCNTL_IR_BYPASS_FILTERING_APPLIED=0x00;
const uint8_t KX126_ODCNTL_IR_BYPASS_FILTER_BYPASSED=0x80;
const uint8_t KX126_ODCNTL_LPRO_ODR_9=0x00;
const uint8_t KX126_ODCNTL_LPRO_ODR_2=0x40;
const uint8_t KX126_ODCNTL_OSA_OUTPUT_DATA_RATE_12_5Hz=0x00;
const uint8_t KX126_ODCNTL_OSA_OUTPUT_DATA_RATE_25Hz=0x01;
const uint8_t KX126_ODCNTL_OSA_OUTPUT_DATA_RATE_50Hz=0x02;
const uint8_t KX126_ODCNTL_OSA_OUTPUT_DATA_RATE_100Hz=0x03;
const uint8_t KX126_ODCNTL_OSA_OUTPUT_DATA_RATE_200Hz=0x04;
const uint8_t KX126_ODCNTL_OSA_OUTPUT_DATA_RATE_400Hz=0x05;
const uint8_t KX126_ODCNTL_OSA_OUTPUT_DATA_RATE_800Hz=0x06;
const uint8_t KX126_ODCNTL_OSA_OUTPUT_DATA_RATE_1600Hz=0x07;
const uint8_t KX126_ODCNTL_OSA_OUTPUT_DATA_RATE_0_781Hz=0x08;
const uint8_t KX126_ODCNTL_OSA_OUTPUT_DATA_RATE_1_563Hz=0x09;
const uint8_t KX126_ODCNTL_OSA_OUTPUT_DATA_RATE_3_125Hz=0x0A;
const uint8_t KX126_ODCNTL_OSA_OUTPUT_DATA_RATE_6_25Hz=0x0B;
const uint8_t KX126_ODCNTL_OSA_OUTPUT_DATA_RATE_3200Hz=0x0C;
const uint8_t KX126_ODCNTL_OSA_OUTPUT_DATA_RATE_6400Hz=0x0D;
const uint8_t KX126_ODCNTL_OSA_OUTPUT_DATA_RATE_12800Hz=0x0E;
const uint8_t KX126_ODCNTL_OSA_OUTPUT_DATA_RATE_25600Hz=0x0F;

/* Interrupt Control 1 */
const uint8_t KX126_INC1_PULSE_INTERRUPT_1_50uSec=0x00;
const uint8_t KX126_INC1_PULSE_INTERRUPT_1_OSA_PERIOD=0x40;
const uint8_t KX126_INC1_PULSE_INTERRUPT_1_OSA2_PERIOD=0x80;
const uint8_t KX126_INC1_PULSE_INTERRUPT_1_OSA4_PERIOD=0xC0;
const uint8_t KX126_INC1_PHYSICAL_INTERRUPT_DISABLE=0x00;
const uint8_t KX126_INC1_PHYSICAL_INTERRUPT_ENABLE=0x20;
const uint8_t KX126_INC1_INTERRUPT_ACTIVE_LEVEL_LOW=0x00;
const uint8_t KX126_INC1_INTERRUPT_ACTIVE_LEVEL_HIGH=0x10;
const uint8_t KX126_INC1_INTERRUPT_LATCHED=0x00;
const uint8_t KX126_INC1_INTERRUPT_PULSED=0x08;
const uint8_t KX126_INC1_SELF_TEST_POLARITY_NEGATIVE=0x00;
const uint8_t KX126_INC1_SELF_TEST_POLARITY_POSITIVE=0x02;
const uint8_t KX126_INC1_3_WIRE_SPI_INTERFACE_DISABLE=0x00;
const uint8_t KX126_INC1_3_WIRE_SPI_INTERFACE_ENABLED=0x01;

/* Interrupt Control 2 */
const uint8_t KX126_INC2_AOI_ACTIVE_STATE_IN_OR=0x00;
const uint8_t KX126_INC2_AOI_ACTIVE_STATE_IN_AND=0x40;
const uint8_t KX126_INC2_X_NEGATIVE_DISABLE=0x00;
const uint8_t KX126_INC2_X_NEGATIVE_ENABEL=0x20;
const uint8_t KX126_INC2_Y_NEGATIVE_DISABLE=0x00;
const uint8_t KX126_INC2_Y_NEGATIVE_ENABEL=0x08;
const uint8_t KX126_INC2_Z_NEGATIVE_DISABLE=0x00;
const uint8_t KX126_INC2_Z_NEGATIVE_ENABEL=0x02;
const uint8_t KX126_INC2_X_POSITIVE_DISABLE=0x00;
const uint8_t KX126_INC2_X_POSITIVE_ENABEL=0x10;
const uint8_t KX126_INC2_Y_POSITIVE_DISABLE=0x00;
const uint8_t KX126_INC2_Y_POSITIVE_ENABEL=0x04;
const uint8_t KX126_INC2_Z_POSITIVE_DISABLE=0x00;
const uint8_t KX126_INC2_Z_POSITIVE_ENABEL=0x01;

/* Interrupt Control 3 */
const uint8_t KX126_INC3_ALTERNATE_TAP_DISABLE=0x00;
const uint8_t KX126_INC3_ALTERNATE_TAP_ENABLE=0x40;
const uint8_t KX126_INC3_LEFT_STATE_DISABLE=0x00;
const uint8_t KX126_INC3_LEFT_STATE_ENABLE=0x20;
const uint8_t KX126_INC3_RIGHT_STATE_DISABLE=0x00;
const uint8_t KX126_INC3_RIGHT_STATE_ENABLE=0x10;
const uint8_t KX126_INC3_DOWN_STATE_DISABLE=0x00;
const uint8_t KX126_INC3_DOWN_STATE_ENABLE=0x08;
const uint8_t KX126_INC3_UP_STATE_DISABLE=0x00;
const uint8_t KX126_INC3_UP_STATE_ENABLE=0x04;
const uint8_t KX126_INC3_FACE_DOWN_STATE_DISABLE=0x00;
const uint8_t KX126_INC3_FACE_DOWN_STATE_ENABLE=0x02;
const uint8_t KX126_INC3_FACE_UP_STATE_DISABLE=0x00;
const uint8_t KX126_INC3_FACE_UP_STATE_ENABLE=0x01;

/* Interrupt Control 4 */
const uint8_t KX126_INC4_FREE_FALL_INTERRUPT_1_DISABLE=0x00;
const uint8_t KX126_INC4_FREE_FALL_INTERRUPT_1_ENABLE=0x80;
const uint8_t KX126_INC4_BUFFER_FULL_INTERRUPT_1_DISABLE=0x00;
const uint8_t KX126_INC4_BUFFER_FULL_INTERRUPT_1_ENABLE=0x40;
const uint8_t KX126_INC4_WATERMARK_INTERRUPT_1_DISABLE=0x00;
const uint8_t KX126_INC4_WATERMARK_INTERRUPT_1_ENABLE=0x20;
const uint8_t KX126_INC4_DATA_READY_INTERRUPT_1_DISABLE=0x00;
const uint8_t KX126_INC4_DATA_READY_INTERRUPT_1_ENABLE=0x10;
const uint8_t KX126_INC4_BACK_TO_SLEEP_INTERRUPT_1_DISABLE=0x00;
const uint8_t KX126_INC4_BACK_TO_SLEEP_INTERRUPT_1_ENABLE=0x08;
const uint8_t KX126_INC4_TAP_INTERRUPT_1_DISABLE=0x00;
const uint8_t KX126_INC4_TAP_INTERRUPT_1_ENABLE=0x04;
const uint8_t KX126_INC4_WAKE_UP_INTERRUPT_1_DISABLE=0x00;
const uint8_t KX126_INC4_WAKE_UP_INTERRUPT_1_ENABLE=0x02;
const uint8_t KX126_INC4_TILT_POSITION_INTERRUPT_1_DISABLE=0x00;
const uint8_t KX126_INC4_TILT_POSITION_INTERRUPT_1_ENABLE=0x01;

/* Interrupt Control 5 */
const uint8_t KX126_INC5_PULSE_INTERRUPT_2_50uSec=0x00;
const uint8_t KX126_INC5_PULSE_INTERRUPT_2_OSA_PERIOD=0x40;
const uint8_t KX126_INC5_PULSE_INTERRUPT_2_OSA2_PERIOD=0x80;
const uint8_t KX126_INC5_PULSE_INTERRUPT_2_OSA4_PERIOD=0xC0;
const uint8_t KX126_INC5_PHYSICAL_INTERRUPT_DISABLE=0x00;
const uint8_t KX126_INC5_PHYSICAL_INTERRUPT_ENABLE=0x20;
const uint8_t KX126_INC5_INTERRUPT_ACTIVE_LEVEL_LOW=0x00;
const uint8_t KX126_INC5_INTERRUPT_ACTIVE_LEVEL_HIGH=0x10;
const uint8_t KX126_INC5_INTERRUPT_LATCHED=0x00;
const uint8_t KX126_INC5_INTERRUPT_PULSED=0x08;
const uint8_t KX126_INC5_LATCHED_INTERRUPT_2_DISABLE=0x00;
const uint8_t KX126_INC5_LATCHED_INTERRUPT_2_ENABLE=0x02;
const uint8_t KX126_INC5_LATCHED_INTERRUPT_1_DISABLE=0x00;
const uint8_t KX126_INC5_LATCHED_INTERRUPT_1_ENABLE=0x01;

/* Interrupt Control 6 */
const uint8_t KX126_INC6_FREE_FALL_INTERRUPT_2_DISABLE=0x00;
const uint8_t KX126_INC6_FREE_FALL_INTERRUPT_2_ENABLE=0x80;
const uint8_t KX126_INC6_BUFFER_FULL_INTERRUPT_2_DISABLE=0x00;
const uint8_t KX126_INC6_BUFFER_FULL_INTERRUPT_2_ENABLE=0x40;
const uint8_t KX126_INC6_WATERMARK_INTERRUPT_2_DISABLE=0x00;
const uint8_t KX126_INC6_WATERMARK_INTERRUPT_2_ENABLE=0x20;
const uint8_t KX126_INC6_DATA_READY_INTERRUPT_2_DISABLE=0x00;
const uint8_t KX126_INC6_DATA_READY_INTERRUPT_2_ENABLE=0x10;
const uint8_t KX126_INC6_BACK_TO_SLEEP_INTERRUPT_2_DISABLE=0x00;
const uint8_t KX126_INC6_BACK_TO_SLEEP_INTERRUPT_2_ENABLE=0x08;
const uint8_t KX126_INC6_TAP_INTERRUPT_2_DISABLE=0x00;
const uint8_t KX126_INC6_TAP_INTERRUPT_2_ENABLE=0x04;
const uint8_t KX126_INC6_WAKE_UP_INTERRUPT_2_DISABLE=0x00;
const uint8_t KX126_INC6_WAKE_UP_INTERRUPT_2_ENABLE=0x02;
const uint8_t KX126_INC6_TILT_POSITION_INTERRUPT_2_DISABLE=0x00;
const uint8_t KX126_INC6_TILT_POSITION_INTERRUPT_2_ENABLE=0x01;

/* Interrupt Control 7 */
const uint8_t KX126_INC7_STEP_OVERFLOW_INTERRUPT_2_DISABLE=0x00;
const uint8_t KX126_INC7_STEP_OVERFLOW_INTERRUPT_2_ENABLE=0x40;
const uint8_t KX126_INC7_STEP_WATERMARK_INTERRUPT_2_DISABLE=0x00;
const uint8_t KX126_INC7_STEP_WATERMARK_INTERRUPT_2_ENABLE=0x20;
const uint8_t KX126_INC7_STEP_INCREMENT_INTERRUPT_2_DISABLE=0x00;
const uint8_t KX126_INC7_STEP_INCREMENT_INTERRUPT_2_ENABLE=0x10;
const uint8_t KX126_INC7_STEP_OVERFLOW_INTERRUPT_1_DISABLE=0x00;
const uint8_t KX126_INC7_STEP_OVERFLOW_INTERRUPT_1_ENABLE=0x04;
const uint8_t KX126_INC7_STEP_WATERMARK_INTERRUPT_1_DISABLE=0x00;
const uint8_t KX126_INC7_STEP_WATERMARK_INTERRUPT_1_ENABLE=0x02;
const uint8_t KX126_INC7_STEP_INCREMENT_INTERRUPT_1_DISABLE=0x00;
const uint8_t KX126_INC7_STEP_INCREMENT_INTERRUPT_1_ENABLE=0x01;

/* Tap Report Control */
const uint8_t KX126_TDTRC_DOUBLE_TAP_INTERRUPT_DISABLE=0x00;
const uint8_t KX126_TDTRC_DOUBLE_TAP_INTERRUPT_ENABLE=0x02;
const uint8_t KX126_TDTRC_SINGLE_TAP_INTERRUPT_DISABLE=0x00;
const uint8_t KX126_TDTRC_SINGLE_TAP_INTERRUPT_ENABLE=0x01;

/* Free Fall Control */
const uint8_t KX126_FFCNTL_FREE_FALL_DISABLE=0x00;
const uint8_t KX126_FFCNTL_FREE_FALL_ENABLE=0x80;
const uint8_t KX126_FFCNTL_FREE_FALL_INTERRUPT_LATCH_DISABLE=0x00;
const uint8_t KX126_FFCNTL_FREE_FALL_INTERRUPT_UNLATCH_ENABLE=0x40;
const uint8_t KX126_FFCNTL_DEBOUNCE_METHODOLOGY_DISABLE=0x00;
const uint8_t KX126_FFCNTL_DEBOUNCE_METHODOLOGY_ENABLE=0x08;
const uint8_t KX126_FFCNTL_OFFI_OUTPUT_DATA_RATE_12_5Hz=0x00;
const uint8_t KX126_FFCNTL_OFFI_OUTPUT_DATA_RATE_25Hz=0x01;
const uint8_t KX126_FFCNTL_OFFI_OUTPUT_DATA_RATE_50Hz=0x02;
const uint8_t KX126_FFCNTL_OFFI_OUTPUT_DATA_RATE_100Hz=0x03;
const uint8_t KX126_FFCNTL_OFFI_OUTPUT_DATA_RATE_200Hz=0x04;
const uint8_t KX126_FFCNTL_OFFI_OUTPUT_DATA_RATE_400Hz=0x05;
const uint8_t KX126_FFCNTL_OFFI_OUTPUT_DATA_RATE_800Hz=0x06;
const uint8_t KX126_FFCNTL_OFFI_OUTPUT_DATA_RATE_1600Hz=0x07;

/* Low Power Control */
const uint8_t KX126_LP_CNTL_NO_AVERAGING=0x00;
const uint8_t KX126_LP_CNTL_2_SAMPLES_AVERAGED=0x10;
const uint8_t KX126_LP_CNTL_4_SAMPLES_AVERAGED=0x20;
const uint8_t KX126_LP_CNTL_8_SAMPLES_AVERAGED=0x30;
const uint8_t KX126_LP_CNTL_16_SAMPLES_AVERAGED=0x40;
const uint8_t KX126_LP_CNTL_32_SAMPLES_AVERAGED=0x50;
const uint8_t KX126_LP_CNTL_64_SAMPLES_AVERAGED=0x60;
const uint8_t KX126_LP_CNTL_128_SAMPLES_AVERAGED=0x70;

/* Pedometer Control register 1 */
const uint8_t KX126_PED_CNTL1_STEP_TH_NO_STEPS=0x00;
const uint8_t KX126_PED_CNTL1_STEP_TH_2_STEPS=0x01;
const uint8_t KX126_PED_CNTL1_STEP_TH_4_STEPS=0x02;
const uint8_t KX126_PED_CNTL1_STEP_TH_6_STEPS=0x03;
const uint8_t KX126_PED_CNTL1_STEP_TH_8_STEPS=0x04;
const uint8_t KX126_PED_CNTL1_STEP_TH_10_STEPS=0x05;
const uint8_t KX126_PED_CNTL1_STEP_TH_12_STEPS=0x06;
const uint8_t KX126_PED_CNTL1_STEP_TH_14_STEPS=0x07;

/* Pedometer Control register 2 */
const uint8_t KX126_PED_CNTL2_HIGH_PASS_FILTER_1=0x00;
const uint8_t KX126_PED_CNTL2_HIGH_PASS_FILTER_2=0x10;
const uint8_t KX126_PED_CNTL2_HIGH_PASS_FILTER_4=0x20;
const uint8_t KX126_PED_CNTL2_HIGH_PASS_FILTER_8=0x30;
const uint8_t KX126_PED_CNTL2_HIGH_PASS_FILTER_16=0x40;
const uint8_t KX126_PED_CNTL2_HIGH_PASS_FILTER_32=0x50;
const uint8_t KX126_PED_CNTL2_HIGH_PASS_FILTER_64=0x60;
const uint8_t KX126_PED_CNTL2_HIGH_PASS_FILTER_128=0x70;
const uint8_t KX126_PED_CNTL2_ODR_SELECT_100Hz=0x0C;
const uint8_t KX126_PED_CNTL2_ODR_SELECT_50Hz=0x06;

/* Device slave address */
const uint8_t KX126_SLAVE_ADDRESS_0=0x1E;
const uint8_t KX126_SLAVE_ADDRESS_1=0x1F;

/* Current Tilt Position *** Previous Tilt Positon */
const uint8_t KX126_TILT_POSITION_LEFT=1;
const uint8_t KX126_TILT_POSITION_RIGHT=2;
const uint8_t KX126_TILT_POSITION_DOWN=3;
const uint8_t KX126_TILT_POSITION_UP=4;
const uint8_t KX126_TILT_POSITION_FACE_DOWN=5;
const uint8_t KX126_TILT_POSITION_FACE_UP=6;

/* Tap detection */
const uint8_t KX126_TAP_X_NEGATIVE=0x10;
const uint8_t KX126_TAP_X_POSITIVE=0x11;
const uint8_t KX126_TAP_Y_NEGATIVE=0x20;
const uint8_t KX126_TAP_Y_POSITIVE=0x21;
const uint8_t KX126_TAP_Z_NEGATIVE=0x30;
const uint8_t KX126_TAP_Z_POSITIVE=0x31;

/* ---------------------------------------------------------------- VARIABLES */
uint8_t kx126_slv_addr=KX126_SLAVE_ADDR;
static uint8_t kx126_data[32];

/* ----------------------------------------------------------- IMPLEMENTATION */
void KX126_writeByte(uint8_t reg_addr, uint8_t _data)
{
    uint8_t writeReg[2];

    writeReg[0]=reg_addr;
    writeReg[1]=_data;
    KX126_I2C_writeNByte(kx126_slv_addr, writeReg, 2);
}

uint8_t KX126_readByte(uint8_t reg_addr)
{
    uint8_t reg_data=0xFF;

    KX126_I2C_writeNByte(kx126_slv_addr, &reg_addr, 1);
    KX126_I2C_readNByte(kx126_slv_addr, &reg_data, 1);

    return reg_data;
}

void KX126_readData(void)
{
    kx126_data[0]=0x00;
    KX126_I2C_writeNByte(kx126_slv_addr, &kx126_data[0], 1);
    KX126_I2C_readNByte(kx126_slv_addr, &kx126_data[0], 32);
}

void KX126_getAccelAxis(int16_t *x_axis, int16_t *y_axis, int16_t *z_axis)
{
    *x_axis=(((uint16_t) kx126_data[KX126_REG_X_AXIS_OUTPUT_LOW+1])<<8)|kx126_data[KX126_REG_X_AXIS_OUTPUT_LOW];
    *y_axis=(((uint16_t) kx126_data[KX126_REG_Y_AXIS_OUTPUT_LOW+1])<<8)|kx126_data[KX126_REG_Y_AXIS_OUTPUT_LOW];
    *z_axis=(((uint16_t) kx126_data[KX126_REG_Z_AXIS_OUTPUT_LOW+1])<<8)|kx126_data[KX126_REG_Z_AXIS_OUTPUT_LOW];
}

void KX126_getHighPassAccelAxis(int16_t *x_axis, int16_t *y_axis, int16_t *z_axis)
{
    *x_axis=(((uint16_t)kx126_data[KX126_REG_X_AXIS_HIGH_PASS_LOW+1])<<8)|kx126_data[KX126_REG_X_AXIS_HIGH_PASS_LOW];
    *y_axis=(((uint16_t)kx126_data[KX126_REG_Y_AXIS_HIGH_PASS_LOW+1])<<8)|kx126_data[KX126_REG_Y_AXIS_HIGH_PASS_LOW];
    *z_axis=(((uint16_t)kx126_data[KX126_REG_Z_AXIS_HIGH_PASS_LOW+1])<<8)|kx126_data[KX126_REG_Z_AXIS_HIGH_PASS_LOW];
    
    
}

void KX126_startConfiguration(void)
{
    KX126_writeByte(KX126_REG_CONTROL_1, KX126_CNTL1_MODE_STAND_BY|
            KX126_CNTL1_RES_MODE_HIGHER_NOISE|
            KX126_CNTL1_DATA_READY_DISABLE|
            KX126_CNTL1_G_RANGE_2g|
            KX126_CNTL1_PEDOMETER_DISABLE|
            KX126_CNTL1_TILT_DISABLE|
            KX126_CNTL1_TAP_DISABLE);

    KX126_writeByte(KX126_REG_CONTROL_2, KX126_CNTL2_SOFTWARE_RESET_NO_ACTIVE|
            KX126_CNTL2_COMMAND_TEST_NO_ACTIVE|
            KX126_CNTL2_DOWN_STATE_ENABLE|
            KX126_CNTL2_FACE_DOWN_STATE_ENABLE|
            KX126_CNTL2_FACE_UP_STATE_ENABLE|
            KX126_CNTL2_LEFT_STATE_ENABLE|
            KX126_CNTL2_RIGHT_STATE_ENABLE|
            KX126_CNTL2_UP_STATE_ENABLE);

    KX126_writeByte(KX126_REG_CONTROL_3, KX126_CNTL3_OTP_OUTPUT_DATA_RATE_12_5Hz|
            KX126_CNTL3_TAP_OUTPUT_DATA_RATE_400Hz|
            KX126_CNTL3_OWUF_OUTPUT_DATA_RATE_0_781Hz);

    KX126_writeByte(KX126_REG_CONTROL_4, KX126_CNTL4_COUNTER_DECREMENT_MODE|
            KX126_CNTL4_THRESHOLD_MODE_ABSOLUTE|
            KX126_CNTL4_WAKE_UP_DISABLE|
            KX126_CNTL4_BACK_TO_SLEEP_DISABLE|
            KX126_CNTL4_HIGH_PASS_ENABLE|
            KX126_CNTL4_OBTS_OUTPUT_DATA_RATE_0_781Hz);

    KX126_writeByte(KX126_REG_CONTROL_5, KX126_CNTL5_MANUAL_WAKE_UP_0|KX126_CNTL5_MANUAL_SLEEP_UP_0);

    KX126_writeByte(KX126_REG_OUTPUT_DATA_CONTROL, KX126_ODCNTL_IR_BYPASS_FILTERING_APPLIED|
            KX126_ODCNTL_LPRO_ODR_9|
            KX126_ODCNTL_OSA_OUTPUT_DATA_RATE_50Hz);

    KX126_setPedometerStepWatermark(10000);

    KX126_writeByte(KX126_REG_PEDOMETER_CONTROL_2, KX126_PED_CNTL2_HIGH_PASS_FILTER_4|KX126_PED_CNTL2_ODR_SELECT_100Hz);
    KX126_writeByte(KX126_REG_LOW_POWER_CONTROL, 0x7B);

    KX126_writeByte(KX126_REG_INTERRUPT_CONTROL_7, KX126_INC7_STEP_OVERFLOW_INTERRUPT_2_ENABLE|
            KX126_INC7_STEP_WATERMARK_INTERRUPT_2_ENABLE|
            KX126_INC7_STEP_INCREMENT_INTERRUPT_1_ENABLE);

    KX126_writeByte(KX126_REG_INTERRUPT_CONTROL_1, KX126_INC1_PHYSICAL_INTERRUPT_ENABLE);
    KX126_writeByte(KX126_REG_INTERRUPT_CONTROL_5, KX126_INC5_PHYSICAL_INTERRUPT_ENABLE);
    KX126_pedometerCongif(100); // 100Hz or 50Hz
}

void KX126_setPedometerStepWatermark(uint16_t value)
{
    KX126_writeByte(KX126_REG_PED_STPWM_LOW, value>>8);
    KX126_writeByte(KX126_REG_PED_STPWM_HIGH, value&0x00FF);
}

void KX126_pedometerCongif(uint8_t ODR)
{
    if(ODR==100)
    {
        KX126_writeByte(KX126_REG_PEDOMETER_CONTROL_1, 0x66);
        KX126_writeByte(KX126_REG_PEDOMETER_CONTROL_2, 0x2C);
        KX126_writeByte(KX126_REG_PEDOMETER_CONTROL_3, 0x17);
        KX126_writeByte(KX126_REG_PEDOMETER_CONTROL_4, 0x1F);
        KX126_writeByte(KX126_REG_PEDOMETER_CONTROL_5, 0x24);
        KX126_writeByte(KX126_REG_PEDOMETER_CONTROL_6, 0x13);
        KX126_writeByte(KX126_REG_PEDOMETER_CONTROL_7, 0x0B);
        KX126_writeByte(KX126_REG_PEDOMETER_CONTROL_8, 0x08);
        KX126_writeByte(KX126_REG_PEDOMETER_CONTROL_9, 0x19);
        KX126_writeByte(KX126_REG_PEDOMETER_CONTROL_10, 0x1C);
    }
    else
    {
        KX126_writeByte(KX126_REG_PEDOMETER_CONTROL_1, 0x56);
        KX126_writeByte(KX126_REG_PEDOMETER_CONTROL_2, 0x26);
        KX126_writeByte(KX126_REG_PEDOMETER_CONTROL_3, 0x17);
        KX126_writeByte(KX126_REG_PEDOMETER_CONTROL_4, 0x1F);
        KX126_writeByte(KX126_REG_PEDOMETER_CONTROL_5, 0x0E);
        KX126_writeByte(KX126_REG_PEDOMETER_CONTROL_6, 0x0B);
        KX126_writeByte(KX126_REG_PEDOMETER_CONTROL_7, 0x02);
        KX126_writeByte(KX126_REG_PEDOMETER_CONTROL_8, 0x03);
        KX126_writeByte(KX126_REG_PEDOMETER_CONTROL_9, 0x0D);
        KX126_writeByte(KX126_REG_PEDOMETER_CONTROL_10, 0x10);
    }
}

uint16_t KX126_getPedometerStepCounter(void)
{
    return (((uint16_t)kx126_data[KX126_REG_PAD_STEP_LOW+1])<<8)|kx126_data[KX126_REG_PAD_STEP_LOW];
}

void KX126_getTiltPosition(uint8_t *current_pos, uint8_t *previous_pos)
{
    uint8_t previousTiltPosition;
    uint8_t currentTiltPosition;

    previousTiltPosition=KX126_readByte(KX126_REG_PREVIOUS_TILT_POSITION);
    currentTiltPosition=KX126_readByte(KX126_REG_CURRENT_TILT_POSITION);

    if((currentTiltPosition&0x20)!=0)
    {
        *current_pos=KX126_TILT_POSITION_LEFT;
    }
    else if((currentTiltPosition&0x10)!=0)
    {
        *current_pos=KX126_TILT_POSITION_RIGHT;
    }
    else if((currentTiltPosition&0x08)!=0)
    {
        *current_pos=KX126_TILT_POSITION_DOWN;
    }
    else if((currentTiltPosition&0x04)!=0)
    {
        *current_pos=KX126_TILT_POSITION_UP;
    }
    else if((currentTiltPosition&0x02)!=0)
    {
        *current_pos=KX126_TILT_POSITION_FACE_DOWN;
    }
    else if((currentTiltPosition&0x01)!=0)
    {
        *current_pos=KX126_TILT_POSITION_FACE_UP;
    }

    if((previousTiltPosition&0x20)!=0)
    {
        *previous_pos=KX126_TILT_POSITION_LEFT;
    }
    else if((previousTiltPosition&0x10)!=0)
    {
        *previous_pos=KX126_TILT_POSITION_RIGHT;
    }
    else if((previousTiltPosition&0x08)!=0)
    {
        *previous_pos=KX126_TILT_POSITION_DOWN;
    }
    else if((previousTiltPosition&0x04)!=0)
    {
        *previous_pos=KX126_TILT_POSITION_UP;
    }
    else if((previousTiltPosition&0x02)!=0)
    {
        *previous_pos=KX126_TILT_POSITION_FACE_DOWN;
    }
    else if((previousTiltPosition&0x01)!=0)
    {
        *previous_pos=KX126_TILT_POSITION_FACE_UP;
    }
}

void KX126_getTapDetection(uint8_t *tap)
{
    uint8_t readTap;

    readTap=KX126_readByte(0x14);

    if((readTap&0x20)!=0)
    {
        *tap=KX126_TAP_X_NEGATIVE;
    }
    else if((readTap&0x10)!=0)
    {
        *tap=KX126_TAP_X_POSITIVE;
    }
    else if((readTap&0x08)!=0)
    {
        *tap=KX126_TAP_Y_NEGATIVE;
    }
    else if((readTap&0x04)!=0)
    {
        *tap=KX126_TAP_Y_POSITIVE;
    }
    else if((readTap&0x02)!=0)
    {
        *tap=KX126_TAP_Z_NEGATIVE;
    }
    else if((readTap&0x01)!=0)
    {
        *tap=KX126_TAP_Z_POSITIVE;
    }
}

uint32_t KX126_GetID(void)
{
    uint32_t main_id=0;

    if(KX126_I2C_writeNByte(kx126_slv_addr, (uint8_t *)&KX126_REG_MANUFACTURING_ID, 1))
    {
        KX126_I2C_readNByte(kx126_slv_addr, (uint8_t *)&main_id, 4);
    }

    return main_id;
}

float KX126_GConvert(uint32_t Value)
{
    double x;

    if(Value>0x7FFF)
    {
        x=(float)(0x10000-Value);
        x*=(-0.00006f);
    }
    else
    {
        x=(float)Value;
        x*=0.00006f;
    }

    return (float) x;
}

bool KX126_Init(void)
{
    uint32_t ID=KX126_GetID();

    __db("%08X ", ID);

    if(ID==MAIN_ID_VAL)
    {
        KX126_startConfiguration();
        KX126_writeByte(KX126_REG_CONTROL_1, KX126_CNTL1_MODE_LOW_POWER|
                KX126_CNTL1_RES_MODE_LOWER_NOISE|
                KX126_CNTL1_DATA_READY_DISABLE|
                KX126_CNTL1_G_RANGE_2g|
                KX126_CNTL1_TAP_ENABLE|
                KX126_CNTL1_PEDOMETER_ENABLE|
                KX126_CNTL1_TILT_ENABLE);
        return 1;
    }

    return 0;
}